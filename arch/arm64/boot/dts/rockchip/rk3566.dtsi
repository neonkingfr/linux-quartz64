// SPDX-License-Identifier: (GPL-2.0+ OR MIT)

#include "rk3568.dtsi"

/ {
	compatible = "rockchip,rk3566";
};

&cpu0_opp_table {
	/delete-node/ opp-1992000000;
};

&power {
	power-domain@RK3568_PD_PIPE {
		pm_qos = <&qos_pcie2x1>,
			 <&qos_sata1>,
			 <&qos_sata2>,
			 <&qos_usb3_0>,
			 <&qos_usb3_1>;
	};
};

/delete-node/ &qos_pcie3x1;
/delete-node/ &qos_pcie3x2;
/delete-node/ &qos_sata0;
